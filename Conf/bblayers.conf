## Conf/bblayers.conf
```bitbake
# POKY_BBLAYERS_CONF_VERSION is increased each time build/conf/bblayers.conf
# changes incompatibly
POKY_BBLAYERS_CONF_VERSION = "2"

BBPATH = "${TOPDIR}"
BBFILES ?= ""

BBLAYERS ?= " \
  /home/daro/poky/meta \
  /home/daro/poky/meta-poky \
  /home/daro/poky/meta-yocto-bsp \
  /home/daro/poky/meta-openembedded/meta-oe \
  /home/daro/poky/meta-openembedded/meta-gnome \
  /home/daro/poky/meta-openembedded/meta-xfce \
  /home/daro/poky/meta-openembedded/meta-multimedia \
  /home/daro/poky/meta-openembedded/meta-python \
  /home/daro/poky/meta-openembedded/meta-networking \
  "
```

## Entregables/meta-vigilante/conf/layer.conf
```bitbake
# We have a conf and classes directory, add to BBPATH 
BBPATH .= ":${LAYERDIR}" 
# We have a packages directory, add to BBFILES 
BBFILES += "${LAYERDIR}/recipes-*/*.bb \ 
            ${LAYERDIR}/recipes-*/*/*.bbappend "
BBFILE_COLLECTIONS += "vigilante" 
BBFILE_PATTERN_vigilante = "^${LAYERDIR}/" 
BBFILE_PRIORITY_vigilante = "6"
LAYERVERSION_vigilante = "1"
LAYERSERIES_COMPAT_vigilante = "warrior"
```
